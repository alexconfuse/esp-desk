## sdkconfig.defaults
```kconfig
CONFIG_IDF_TARGET="esp32s31"
CONFIG_COMPILER_OPTIMIZATION_PERF=y
CONFIG_FREERTOS_HZ=1000
CONFIG_PARTITION_TABLE_SINGLE_APP_LARGE=y

# Mosaico CO5300 QSPI display + CST9217 touch (via esp-mosaico-bsp)
CONFIG_BSP_CO5300_ENABLE_TE=y

# LVGL 9 (pulled by esp-mosaico-bsp)
CONFIG_LV_CONF_SKIP=y
CONFIG_LV_COLOR_DEPTH_16=y
CONFIG_LV_OS_FREERTOS=y
CONFIG_LV_DEF_REFR_PERIOD=15
CONFIG_LV_DPI_DEF=60
CONFIG_LV_USE_CLIB_MALLOC=y
CONFIG_LV_USE_CLIB_STRING=y
CONFIG_LV_USE_CLIB_SPRINTF=y
CONFIG_LV_FONT_MONTSERRAT_18=y
CONFIG_LV_FONT_MONTSERRAT_24=y
CONFIG_LV_FONT_DEFAULT_MONTSERRAT_18=y

# QSPI frame buffers from PSRAM (esp_lvgl_adapter)
CONFIG_SPIRAM=y
CONFIG_SPIRAM_SPEED_250M=y
CONFIG_SPIRAM_XIP_FROM_PSRAM=y
CONFIG_SPIRAM_MEMTEST=n

# Wi‑Fi SoftAP + STA provisioning / settings
CONFIG_ESP_WIFI_SOFTAP_SUPPORT=y
CONFIG_LWIP_MAX_SOCKETS=16

# mDNS → http://desk-buddy.local/
CONFIG_MDNS_MAX_SERVICES=10

# HTTPS to OpenAI-compatible hosts
CONFIG_ESP_TLS_USING_MBEDTLS=y
CONFIG_MBEDTLS_CERTIFICATE_BUNDLE=y
CONFIG_MBEDTLS_CERTIFICATE_BUNDLE_DEFAULT_FULL=y
CONFIG_ESP_HTTP_CLIENT_ENABLE_HTTPS=y
```
